/*
 * Shared base keymap — included by all board-specific wrappers.
 *
 * Board wrappers can override before including this file:
 *   THUMBS            — key positions for HRM hold-trigger (default: LH2 LH1 RH1 RH2)
 *   LH_NONE / RH_NONE — set to &none for boards with >4 thumbs (pads inner thumbs)
 *   SKIP_SYSTEM_LAYER — define to omit the System layer (for boards with custom system layers)
 */

#include "includes/features.dtsi"
#include "includes/defines.dtsi"
#include "includes/layouts.dtsi"
#include "includes/macros.dtsi"
#include "includes/behaviors.dtsi"
#include "includes/thumbs.dtsi"
#include "includes/combos.dtsi"
#include "includes/leader.dtsi"
#include "includes/mouse.dtsi"
#include "includes/selections.dtsi"

/* Keymap */

ZMK_CONDITIONAL_LAYER(sys, FN NUM, SYS) // FN + NUM --> SYS.
// ZMK_COMBO(system_combo, &sl SYS,   LH0 RH0, ALPHA_LAYERS,   COMBO_TERM, COMBO_IDLE)

#ifndef ZMK_BASE_LAYER
  #define ZMK_BASE_LAYER(name, LT5, LT, RT, RT5, LM5, LM, RM, RM5, LB5, LB, RB, RB5, LF, RF, LH, RH, LH1, RH1)                 \
      ZMK_LAYER(name, LT5 LT RT RT5 LM5 LM RM RM5 LB5 LB RB RB5 LF RF LH RH LH1 RH1)
#endif

/* ── Alpha layers ────────────────────────────────────────────────────── */

#include "includes/layers/alpha_night.dtsi"

/* ── Utility layers ──────────────────────────────────────────────────── */


#include "includes/layers/symbol.dtsi"
#include "includes/layers/nav.dtsi"
#include "includes/layers/num.dtsi"
#include "includes/layers/fn.dtsi"
#include "includes/layers/mouse.dtsi"

/* ── System layer ────────────────────────────────────────────────────── */

#ifndef SKIP_SYSTEM_LAYER
#include "includes/layers/system.dtsi"
#endif
