#define CONFIG_WIRELESS
#define ZMK_BASE_LAYER(name, LT5, LT, RT, RT5, LM5, LM, RM, RM5, LB5, LB, RB, RB5, LF, RF, LH, RH, LH1, RH1)                   \
    ZMK_LAYER(                                                                 \
        name,                                                                  \
             LT5 LT RT RT5                                                     \
             LM5 LM RM RM5                                                     \
             LB5 LB RB RB5                                                     \
             LH1 LH RH RH1                                                     \
    )

#include <dt-bindings/zmk/input_transform.h>
#include "imprint.h"
#include "base.keymap"

/{ chosen { zmk,matrix-transform = &imprint_letters_only; }; };

// right hand trackball configuration

&trackball_peripheral_listener {
   input-processors =
    // activate layer 3 within 500ms of the trackball moving
    <&zip_temp_layer MOUSE 500>;
};

//left hand trackball configuration

&trackball_central_listener {
    input-processors =
        // multiply sensitivity by 1, divide by 3 (make it slower for scrolling),
        // <&zip_xy_scaler 1 3>,
        // make this trackball output scrolling events by default instead of cursor movement,
        <&zip_xy_to_scroll_mapper>,
        // invert vertical scrolling so that the view moves in the same direction as the top of the trackball.,
        <&zip_scroll_transform INPUT_TRANSFORM_Y_INVERT>;
};
