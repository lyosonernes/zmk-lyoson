#define CONFIG_WIRELESS
#define ZMK_BASE_LAYER(name, LT5, LT, RT, RT5, LM5, LM, RM, RM5, LB5, LB, RB, RB5, LF, RF, LH, RH, LH1, RH1)                   \
    ZMK_LAYER(                                                                 \
        name,                                                                  \
                 LT RT                                                         \
                 LM RM                                                         \
                 LB RB                                                         \
                 LH RH                                                         \
    )

#include "zmk-helpers/key-labels/36.h"
#include "base.keymap"

/{ chosen { zmk,physical-layout = &foostan_corne_5col_layout; }; };

